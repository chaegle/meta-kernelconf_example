## conf/layer.conf
```bitbake
# We have a conf and classes directory, add to BBPATH
BBPATH .= ":${LAYERDIR}"

# We have recipes-* directories, add to BBFILES
BBFILES += "${LAYERDIR}/recipes-*/*/*.bb \
	${LAYERDIR}/recipes-*/*/*.bbappend"

BBFILE_COLLECTIONS += "kernelconf_example"
BBFILE_PATTERN_kernelconf_example = "^${LAYERDIR}/"
BBFILE_PRIORITY_kernelconf_example = "6"

LAYERSERIES_COMPAT_kernelconf_example = "warrior zeus"
```
